## firmware/buildroot-external-kamish/configs/kamish_orangepi_4_pro_defconfig
```kconfig
# Architecture
BR2_aarch64=y
BR2_cortex_a55=y

# External Toolchain (Bootlin precompiled AArch64 glibc stable)
# Saves 40-50 minutes by downloading a prebuilt toolchain instead of compiling GCC from source
BR2_TOOLCHAIN_EXTERNAL=y
BR2_TOOLCHAIN_EXTERNAL_BOOTLIN=y
BR2_TOOLCHAIN_EXTERNAL_BOOTLIN_AARCH64_GLIBC_STABLE=y
BR2_CCACHE=y
BR2_CCACHE_DIR="/home/builder/.buildroot-ccache"
BR2_CCACHE_INITIAL_SETUP="--max-size=5G"

# System Configuration
BR2_TARGET_GENERIC_HOSTNAME="kamish"
BR2_TARGET_GENERIC_ISSUE="Welcome to KAMISH OS (Orange Pi 4 Pro Allwinner A733)"
BR2_INIT_SYSTEMD=y
BR2_SYSTEM_BIN_SH_BASH=y
BR2_ROOTFS_USERS_TABLES="$(BR2_EXTERNAL_KAMISH_PATH)/board/kamish/orangepi-4-pro/users.table"
BR2_ROOTFS_OVERLAY="$(BR2_EXTERNAL_KAMISH_PATH)/board/kamish/orangepi-4-pro/overlay"

# Linux Kernel (Official Orange Pi BSP 6.6 sun60iw2 for Allwinner A733)
BR2_LINUX_KERNEL=y
BR2_LINUX_KERNEL_CUSTOM_GIT=y
BR2_LINUX_KERNEL_CUSTOM_REPO_URL="https://github.com/orangepi-xunlong/linux-orangepi.git"
BR2_LINUX_KERNEL_CUSTOM_REPO_VERSION="orange-pi-6.6-sun60iw2"
BR2_LINUX_KERNEL_USE_ARCH_DEFAULT_CONFIG=y
BR2_LINUX_KERNEL_DTS_SUPPORT=y
BR2_LINUX_KERNEL_INTREE_DTS_NAME="allwinner/sun60i-a733-orangepi-4-pro"
BR2_LINUX_KERNEL_INSTALL_TARGET=y
BR2_LINUX_KERNEL_CONFIG_FRAGMENT_FILES="$(BR2_EXTERNAL_KAMISH_PATH)/board/kamish/orangepi-4-pro/linux.fragment"

# Bootloader Tools (mkimage for boot.scr; firmware uses vendor sun60iw2 bootloader in board/kamish/orangepi-4-pro/bootloader)
BR2_PACKAGE_HOST_UBOOT_TOOLS=y
BR2_PACKAGE_HOST_UBOOT_TOOLS_BOOT_SCRIPT=y
BR2_PACKAGE_HOST_UBOOT_TOOLS_BOOT_SCRIPT_SOURCE="$(BR2_EXTERNAL_KAMISH_PATH)/board/kamish/orangepi-4-pro/boot.cmd"

# Root Filesystem and Genimage
BR2_TARGET_ROOTFS_EXT2=y
BR2_TARGET_ROOTFS_EXT2_4=y
BR2_TARGET_ROOTFS_EXT2_SIZE="1024M"
BR2_TARGET_ROOTFS_TAR=y
BR2_TARGET_ROOTFS_TAR_GZIP=y
BR2_PACKAGE_HOST_E2FSPROGS=y
BR2_PACKAGE_E2FSPROGS=y
BR2_PACKAGE_HOST_GENIMAGE=y
BR2_ROOTFS_POST_IMAGE_SCRIPT="$(BR2_EXTERNAL_KAMISH_PATH)/board/kamish/orangepi-4-pro/post-image.sh"
BR2_ROOTFS_POST_SCRIPT_ARGS="-c $(BR2_EXTERNAL_KAMISH_PATH)/board/kamish/orangepi-4-pro/genimage.cfg"

# Core Utilities and Network
BR2_PACKAGE_DROPBEAR=y
BR2_PACKAGE_RAUC=y
BR2_PACKAGE_RAUC_NETWORK=y
BR2_PACKAGE_ALSA_LIB=y
BR2_PACKAGE_ALSA_UTILS=y
BR2_PACKAGE_ALSA_UTILS_APLAY=y
BR2_PACKAGE_ALSA_UTILS_AMIXER=y
BR2_PACKAGE_MPV=y
BR2_PACKAGE_SQLITE=y
BR2_PACKAGE_CA_CERTIFICATES=y

# Wireless, Wi-Fi Stack, and NetworkManager
BR2_PACKAGE_WIRELESS_REGDB=y
BR2_PACKAGE_IW=y
BR2_PACKAGE_WPA_SUPPLICANT=y
BR2_PACKAGE_WPA_SUPPLICANT_NL80211=y
BR2_PACKAGE_WPA_SUPPLICANT_AP_SUPPORT=y
BR2_PACKAGE_WPA_SUPPLICANT_PASSPHRASE=y
BR2_PACKAGE_HOSTAPD=y
BR2_PACKAGE_HOSTAPD_HAS_WIFI_DRIVERS=y
BR2_PACKAGE_NETWORK_MANAGER=y
BR2_PACKAGE_NETWORK_MANAGER_NMCLI=y
BR2_PACKAGE_DNSMASQ=y
BR2_PACKAGE_AVAHI=y
BR2_PACKAGE_AVAHI_DAEMON=y
BR2_PACKAGE_AVAHI_LIBDNSSD_COMPATIBILITY=y

# KAMISH Packages
BR2_PACKAGE_KAMISH=y
BR2_PACKAGE_KAMISH_HEALTHCHECK=y
```

## firmware/buildroot-external-kamish/configs/kamish_orangepi_zero3_defconfig
```kconfig
# Architecture
BR2_aarch64=y
BR2_cortex_a53=y

# System Configuration
BR2_TARGET_GENERIC_HOSTNAME="kamish"
BR2_TARGET_GENERIC_ISSUE="Welcome to KAMISH OS (Orange Pi Zero 3 Allwinner H618)"
BR2_INIT_SYSTEMD=y
BR2_SYSTEM_BIN_SH_BASH=y
BR2_ROOTFS_OVERLAY="$(BR2_EXTERNAL_KAMISH_PATH)/board/kamish/orangepi-zero3/overlay"

# Linux Kernel
BR2_LINUX_KERNEL=y
BR2_LINUX_KERNEL_CUSTOM_VERSION=y
BR2_LINUX_KERNEL_CUSTOM_VERSION_VALUE="6.6.21"
BR2_LINUX_KERNEL_USE_ARCH_DEFAULT_CONFIG=y
BR2_LINUX_KERNEL_DTS_SUPPORT=y
BR2_LINUX_KERNEL_INTREE_DTS_NAME="allwinner/sun50i-h618-orangepi-zero3"
BR2_LINUX_KERNEL_INSTALL_TARGET=y

# Bootloader
BR2_TARGET_UBOOT=y
BR2_TARGET_UBOOT_BUILD_SYSTEM_KCONFIG=y
BR2_TARGET_UBOOT_CUSTOM_VERSION=y
BR2_TARGET_UBOOT_CUSTOM_VERSION_VALUE="2024.01"
BR2_TARGET_UBOOT_BOARD_DEFCONFIG="orangepi_zero3"
BR2_TARGET_UBOOT_NEEDS_DTC=y
BR2_TARGET_UBOOT_NEEDS_PYLIBFDT=y
BR2_TARGET_UBOOT_NEEDS_ATF_BL31=y
BR2_TARGET_UBOOT_FORMAT_BIN=y
BR2_TARGET_UBOOT_SPL=y
BR2_TARGET_UBOOT_SPL_NAME="u-boot-sunxi-with-spl.bin"

# Root Filesystem and Genimage
BR2_TARGET_ROOTFS_EXT2=y
BR2_TARGET_ROOTFS_EXT2_4=y
BR2_TARGET_ROOTFS_EXT2_SIZE="1024M"
BR2_PACKAGE_HOST_GENIMAGE=y
BR2_ROOTFS_POST_IMAGE_SCRIPT="support/scripts/genimage.sh"
BR2_ROOTFS_POST_SCRIPT_ARGS="-c $(BR2_EXTERNAL_KAMISH_PATH)/board/kamish/orangepi-zero3/genimage.cfg"

# Core Utilities and Network
BR2_PACKAGE_DROPBEAR=y
BR2_PACKAGE_RAUC=y
BR2_PACKAGE_RAUC_NETWORK=y
BR2_PACKAGE_SING_BOX=y
BR2_PACKAGE_ALSA_LIB=y
BR2_PACKAGE_ALSA_UTILS=y
BR2_PACKAGE_ALSA_UTILS_APLAY=y
BR2_PACKAGE_ALSA_UTILS_AMIXER=y
BR2_PACKAGE_MPV=y
BR2_PACKAGE_SQLITE=y
BR2_PACKAGE_CA_CERTIFICATES=y

# KAMISH Packages
BR2_PACKAGE_KAMISH=y
BR2_PACKAGE_KAMISH_HEALTHCHECK=y
```

## firmware/buildroot-external-kamish/package/kamish-healthcheck/Config.in
```kconfig
config BR2_PACKAGE_KAMISH_HEALTHCHECK
	bool "kamish-healthcheck"
	select BR2_PACKAGE_RAUC
	help
	  KAMISH OS post-boot verification and RAUC slot confirmation service.
```

## firmware/buildroot-external-kamish/package/kamish/Config.in
```kconfig
config BR2_PACKAGE_KAMISH
	bool "kamish"
	select BR2_PACKAGE_SQLITE
	select BR2_PACKAGE_ALSA_LIB
	select BR2_PACKAGE_ALSA_UTILS
	select BR2_PACKAGE_RAUC
	select BR2_PACKAGE_DROPBEAR
	help
	  Kamish hardware daemon (kamish-core) and web panel (kamish-web).
	  Media playback is kept optional outside the base firmware package,
	  because the mpv subtitle stack pulls in libass/freetype/harfbuzz and
	  breaks the Buildroot cross-toolchain in CI.
```
